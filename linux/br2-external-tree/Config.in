## linux/br2-external-tree/Config.in
```kconfig
source "$BR2_EXTERNAL_WALLY_PATH/package/fbdoom/Config.in"
source "$BR2_EXTERNAL_WALLY_PATH/package/doom-demo/Config.in"
```

## linux/br2-external-tree/configs/wally_defconfig
```kconfig
BR2_riscv=y
BR2_RISCV_ISA_RVC=y
BR2_PACKAGE_HOST_LINUX_HEADERS_CUSTOM_6_11=y
BR2_BINUTILS_VERSION_2_43_X=y
BR2_GCC_VERSION_14_X=y
# BR2_TOOLCHAIN_BUILDROOT_CXX is not set
# BR2_TOOLCHAIN_BUILDROOT_FORTRAN is not set
BR2_BACKUP_SITE="http://sources.buildroot.net"
BR2_GNU_MIRROR="http://ftpmirror.gnu.org"
# BR2_ENABLE_DEBUG is not set
# BR2_DEBUG_3 is not set
BR2_STRIP_strip=y
BR2_PER_PACKAGE_DIRECTORIES=y
# BR2_PIC_PIE is not set
BR2_SSP_NONE=y
BR2_RELRO_NONE=y
BR2_FORTIFY_SOURCE_NONE=y
BR2_TARGET_GENERIC_HOSTNAME="WallyHostname"
BR2_TARGET_GENERIC_ISSUE="Greetings! This RISC-V Linux image was built for Wally on Buildroot!"
BR2_ROOTFS_DEVICE_TABLE_SUPPORTS_EXTENDED_ATTRIBUTES=y
BR2_SYSTEM_DHCP="eth0"
BR2_GLOBAL_PATCH_DIR="$(BR2_EXTERNAL_WALLY_PATH)/patches"
BR2_ROOTFS_OVERLAY="$(BR2_EXTERNAL_WALLY_PATH)/board/wally/rootfs_overlay"
BR2_ROOTFS_POST_IMAGE_SCRIPT="$(BR2_EXTERNAL_WALLY_PATH)/board/wally/post_image.sh"
BR2_PACKAGE_OVERRIDE_FILE="$(BR2_EXTERNAL_WALLY_PATH)/local.mk"
BR2_LINUX_KERNEL=y
# BR2_LINUX_KERNEL_IMAGE=y
BR2_LINUX_KERNEL_IMAGEGZ=y
BR2_LINUX_KERNEL_CUSTOM_VERSION=y
BR2_LINUX_KERNEL_CUSTOM_VERSION_VALUE="6.12.8"
BR2_LINUX_KERNEL_USE_CUSTOM_CONFIG=y
BR2_LINUX_KERNEL_CUSTOM_CONFIG_FILE="$(BR2_EXTERNAL_WALLY_PATH)/board/wally/linux.config"
BR2_PACKAGE_BUSYBOX_CONFIG="$(BR2_EXTERNAL_WALLY_PATH)/board/wally/busybox.config"
BR2_PACKAGE_COREMARK=y
BR2_PACKAGE_DHRYSTONE=y
# BR2_PACKAGE_RAMSPEED is not set
BR2_PACKAGE_WHETSTONE=y
# BR2_PACKAGE_SDL is not set
BR2_PACKAGE_ZSH=y
# BR2_PACKAGE_UEMACS=y # temporarily disabled due to build issues with gcc 14
#BR2_TARGET_ROOTFS_INITRAMFS=y
# BR2_TARGET_ROOTFS_TAR is not set
BR2_TARGET_ROOTFS_EXT2=y
BR2_TARGET_ROOTFS_EXT2_3=y
BR2_TARGET_OPENSBI=y
BR2_TARGET_OPENSBI_CUSTOM_VERSION=y
BR2_TARGET_OPENSBI_CUSTOM_VERSION_VALUE="1.6"
BR2_TARGET_OPENSBI_PLAT="generic"
# BR2_TARGET_OPENSBI_INSTALL_DYNAMIC_IMG is not set
BR2_TARGET_UBOOT=y
BR2_TARGET_UBOOT_CUSTOM_GIT=y
BR2_TARGET_UBOOT_CUSTOM_REPO_URL="https://github.com/juanschroeder/u-boot.git"
BR2_TARGET_UBOOT_CUSTOM_REPO_VERSION="1d9dbe27b9101c6e7c5c275a1448e8ccc254bca9"
BR2_TARGET_UBOOT_BOARDNAME="openhwgroup_cvwsoc_nexysa7"
BR2_TARGET_UBOOT_USE_DEFCONFIG=y
BR2_TARGET_UBOOT_BOARD_DEFCONFIG="openhwgroup_cvwsoc_nexysa7_defconfig"
BR2_PACKAGE_HOST_E2FSPROGS=y
BR2_PACKAGE_HOST_QEMU=y
BR2_PACKAGE_HOST_QEMU_SYSTEM_MODE=y
# Extra for ethernet
BR2_PACKAGE_IPROUTE2=y
BR2_PACKAGE_ETHTOOL=y
BR2_PACKAGE_ETHTOOL_PRETTY_PRINT=y
BR2_PACKAGE_IFUPDOWN=y
BR2_PACKAGE_IFUPDOWN_SCRIPTS=y
BR2_PACKAGE_NET_TOOLS=y
BR2_PACKAGE_DROPBEAR=y
BR2_PACKAGE_IPUTILS=y
BR2_PACKAGE_MEMTESTER=y
BR2_PACKAGE_LMBENCH=y
BR2_PACKAGE_MBW=y
# udev is crashing
#BR2_ROOTFS_DEVICE_CREATION_DYNAMIC_EUDEV=y
#BR2_PACKAGE_USBUTILS=y
BR2_PACKAGE_LINUX_TOOLS_USBTOOLS=y
BR2_PACKAGE_LINUX_TOOLS_USBTOOLS_TESTUSB=y
# fbDOOM
BR2_PACKAGE_FBDOOM=y
# chocolate doom might not be working but it's a dependency of DOOM_WAD
BR2_PACKAGE_CHOCOLATE_DOOM=y
BR2_PACKAGE_DOOM_WAD=y
BR2_PACKAGE_DOOM_DEMO=y
# Firmware for an USB Ethernet device that worked in Linux
BR2_PACKAGE_LINUX_FIRMWARE=y
BR2_PACKAGE_LINUX_FIRMWARE_RTL_815X=y
# FB stuff
BR2_PACKAGE_FB_TEST_APP=y
BR2_PACKAGE_FBSET=y
BR2_PACKAGE_FBV=y
BR2_PACKAGE_FBV_JPEG=y
BR2_PACKAGE_FBGRAB=y
#other utils
BR2_PACKAGE_HTOP=y
BR2_PACKAGE_STRACE=y
```

## linux/br2-external-tree/package/doom-demo/Config.in
```kconfig
config BR2_PACKAGE_DOOM_DEMO
	bool "doom-demo"
	help
	  Installs the Doom timedemo file bounce1.lmp to:
	    /usr/share/games/doom/bounce1.lmp

	  And installs helper scripts:
	    /usr/bin/doom-short-demo.sh
	    /usr/bin/doom-demo.sh

	  Runtime requires:
	    - fbdoom in PATH
	    - /usr/share/games/doom/doom1.wad present (from your doom-wad package)
```

## linux/br2-external-tree/package/fbdoom/Config.in
```kconfig
config BR2_PACKAGE_FBDOOM
	bool "fbdoom"
	help
	    This will install FB Doom by Maxim Evince, John Carmack
```
